/*
 * Hoverboard libopencm3 port — it.c (interrupt handlers)
 *
 * Clean libopencm3 rewrite of HoverBoardGigaDevice/Src/it.c. ISR names
 * follow the libopencm3 convention (lowercase _isr) which is what the
 * vector tables generated by libopencm3 dispatch to.
 */

#include <libopencm3/cm3/nvic.h>
#include <libopencm3/cm3/scb.h>
#include <libopencm3/stm32/timer.h>
#include <libopencm3/stm32/dma.h>
#include <libopencm3/stm32/adc.h>
#include <libopencm3/stm32/usart.h>

#include <stdint.h>

/* Externs from setup.c / main.c — actual definitions come from those
 * files. For per-file compile we just need the declarations. */
extern volatile uint16_t adc_buffer[];
extern volatile uint8_t  usart0_rx_buf[];

/* These are normally defined elsewhere in the project. Stubs for now so
 * it.c compiles in isolation; the ports of bldc.c / led.c / commsMasterSlave.c
 * will provide the real implementations. */
__attribute__((weak)) void CalculateBLDC(void) {}
__attribute__((weak)) void CalculateLEDProgram(void) {}
__attribute__((weak)) void SetUpperLEDMaster(int state) { (void)state; }
__attribute__((weak)) void usart0_rx_complete(void) {}

#define TIMEOUT_MS 2000

uint32_t msTicks;
uint32_t timeoutCounter_ms = 0;
volatile int timedOut = 0;
#ifdef SLAVE
uint32_t hornCounter_ms = 0;
#endif

extern int32_t steer;
extern int32_t speed;
extern volatile int activateWeakening;
extern volatile int beepsBackwards;

/* Per-family aliases mirroring those in setup.c. */
#if defined(GD32F1X0)
#  define HOVER_TIM_TIMEOUT             TIM14
#  define HOVER_TIM1_BRK_UP_ISR         tim1_brk_up_trg_com_isr
#  define HOVER_TIM_TIMEOUT_ISR         tim14_isr
#  define HOVER_DMA1_CH1_ISR            dma1_channel1_isr
#  define HOVER_DMA1_CH4_5_ISR          dma1_channel4_5_isr
#elif defined(GD32F10X)
#  define HOVER_TIM_TIMEOUT             TIM3
#  define HOVER_TIM1_BRK_UP_ISR         tim1_up_isr
#  define HOVER_TIM_TIMEOUT_ISR         tim3_isr
#  define HOVER_DMA1_CH1_ISR            dma1_channel1_isr
#  define HOVER_DMA1_CH4_5_ISR          dma1_channel5_isr
#endif

/* ============================================================
 * SysTick — 1 ms tick.
 * ============================================================ */
void sys_tick_handler(void)
{
    msTicks++;
}

void ResetTimeout(void)
{
    timeoutCounter_ms = 0;
}

/* ============================================================
 * Timeout timer (TIM14 / TIM3) — fires every 2 ms; advances the
 * watchdog-style timeout that detects stale steering commands.
 * ============================================================ */
void HOVER_TIM_TIMEOUT_ISR(void)
{
    if (timer_get_flag(HOVER_TIM_TIMEOUT, TIM_SR_UIF)) {
        timer_clear_flag(HOVER_TIM_TIMEOUT, TIM_SR_UIF);

        if (timeoutCounter_ms > TIMEOUT_MS) {
            if (!timedOut) {
#ifdef MASTER
                steer = 0;
                speed = 0;
                beepsBackwards = 0;
#else
                speed = 0;
#endif
            }
            timedOut = 1;
        } else {
            timedOut = 0;
            timeoutCounter_ms++;
        }

#ifdef SLAVE
        if (hornCounter_ms >= 2000) {
            SetUpperLEDMaster(0);
        } else {
            hornCounter_ms++;
        }
        CalculateLEDProgram();
#endif
    }
}

/* ============================================================
 * TIM1 update IRQ — fires twice per PWM period (up + down) at 16 kHz.
 * Uses interrupt_toggle to fire ADC trigger only once per period.
 * ============================================================ */
uint32_t iPwmCounter = 0, iPwmTime = 0, iPwmRate = 0;

void HOVER_TIM1_BRK_UP_ISR(void)
{
    if (timer_get_flag(TIM1, TIM_SR_UIF)) {
        timer_clear_flag(TIM1, TIM_SR_UIF);

        static uint8_t interrupt_toggle = 0;
        interrupt_toggle = 1 - interrupt_toggle;
        if (interrupt_toggle) {
            /* Fire ADC sample at the PWM valley. */
            adc_start_conversion_regular(ADC1);

            if (msTicks > iPwmTime) {
                iPwmTime = msTicks + 1000;
                iPwmRate = iPwmCounter;
                iPwmCounter = 0;
            } else {
                iPwmCounter++;
            }
        }
    }
}

/* ============================================================
 * DMA1 channel 1 — ADC scan-complete; runs the FOC compute step.
 * ============================================================ */
uint32_t iAdcCounter = 0, iAdcTime = 0, iAdcRate = 0;

void HOVER_DMA1_CH1_ISR(void)
{
    if (dma_get_interrupt_flag(DMA1, DMA_CHANNEL1, DMA_TCIF)) {
        dma_clear_interrupt_flags(DMA1, DMA_CHANNEL1, DMA_TCIF);

        if (msTicks > iAdcTime) {
            iAdcTime = msTicks + 1000;
            iAdcRate = iAdcCounter;
            iAdcCounter = 0;
        } else {
            iAdcCounter++;
        }

        CalculateBLDC();
    }
}

/* ============================================================
 * DMA1 channel 4_5 (F1x0) / channel 5 (F10x) — USART0 RX complete.
 * ============================================================ */
uint32_t iCounterUsart0 = 0;

void HOVER_DMA1_CH4_5_ISR(void)
{
    if (dma_get_interrupt_flag(DMA1, DMA_CHANNEL5, DMA_TCIF)) {
        dma_clear_interrupt_flags(DMA1, DMA_CHANNEL5, DMA_TCIF);
        iCounterUsart0++;
        usart0_rx_complete();
    }
}
